#include "zen.dtsi"
#include <input/processors.dtsi>
#include <dt-bindings/zmk/input_transform.h>

/* スニペット側で定義されているリスナーの処理を完全に上書き・再定義 */
&pointing_listener {
    /* Layer 0など通常状態ではトラックボールを無効化 */
    input-processors = <&zip_xy_scaler 0 1>;

    /*
     * Layer 4ではトラックボールをスクロールとして使用
     */
    /delete-node/ scroller;

    scroller {
        layers = <4>;
        input-processors =
            <&zip_xy_transform (INPUT_TRANSFORM_XY_SWAP | INPUT_TRANSFORM_Y_INVERT)>,
            <&zip_xy_to_scroll_mapper>,
            <&zip_scroll_scaler 2 1>;
    };

    /*
     * Layer 2ではトラックボールを通常のマウスとして使用
     */
    enable_trackball_layer {
        layers = <2>;
        input-processors = <&zip_xy_transform (INPUT_TRANSFORM_XY_SWAP)>;
    };

    /*
     * 自動レイヤー切り替えは使用しない
     */
    /delete-node/ auto_layer;
};

&zen_transform {
    col-offset = <7>;
};
